## eswin_ecr6600_1.0.23/eswin_ecr6600_1.0.23_temp/eswin_ecr6600_os/PS/Kconfig
```kconfig
config ECR_BLE
      bool 
      default y

config BLE_APP_NONE
      bool 
      default y

config COMP_AES
      bool 
      default y

config COMP_ECC_P256
      bool 
      default y

config COMP_H4TL
      bool 
      default y

config COMP_HCI_ADAPT
      bool 
      default y

config COMP_RF
      bool 
      default y

config COMP_RWIP
      bool 
      default y

config BLE_RF_EXTRC
      bool 
      default y

config BLE_PRODUCT_SPLITEMB
      bool 
      default y

config BLE_PRODUCT
      string 
      default "ble-splitemb"

config BLE_BUBBLE
      bool 
      default y

config BLE_ROLE_PERIPHERAL_OBSERVER
      bool 
      default y

config BLE_ROLE
      string 
      default "peripheral&observer"

config LE_ACT
      int 
      default 3

config BLE_HCITL
      bool 
      default y

config MULTIPLEX_UART
      bool 
      default y

config BLE_SEC_CON
      int 
      default 32

config BLE_WLCOEX
      bool 
      default y

config BLE_RAL
      int 
      default 1

config BLE_SCH_PRESENT
      bool 
      default y

config ECR6600_WIFI
      bool 
      default y

config FULLMASK
      bool 
      default y

config WIFI_PRODUCT_FHOST
      bool 
      default y

config WIFI_PRODUCT
      string 
      default "fhost"

config WIFI_UMAC
      bool 
      default y

config WIFI_FHOST
      bool 
      default y

config WIFI_PLATFORM_VIRTEX7
      bool 
      default y

config WIFI_PLATFORM
      string 
      default "virtex7"

config WIFI_VIF
      int 
      default 4

config WIFI_STA
      int 
      default 8

config WIFI_MAC_VERSION21
      bool 
      default y

config WIFI_MAC_VERSION
      int 
      default 21

config WIFI_MDM_V30
      bool 
      default y

config WIFI_MDM_VERSION
      int 
      default 30

config WIFI_IPC_V11
      bool 
      default y

config WIFI_IPC_VERSION
      int 
      default 11

config WIFI_TXDESC0
      int 
      default 4

config WIFI_TXDESC1
      int 
      default 4

config WIFI_TXDESC2
      int 
      default 4

config WIFI_TXDESC3
      int 
      default 4

config WIFI_TXDESC4
      int 
      default 4

config WIFI_DPSM
      bool 
      default y

config WIFI_MON_DATA
      bool 
      default y

config WIFI_REC
      bool 
      default y

config WIFI_BCN
      bool 
      default y

config WIFI_AMSDURX
      int 
      default 8

config WIFI_SPC
      int 
      default 16

config WIFI_BFMEE
      bool 
      default y

config WIFI_BWLEN
      bool 
      default y

config WIFI_KEYCFG
      bool 
      default y

config WIFI_MESH_VIF
      int 
      default 0

config WIFI_MESH_LINK
      int 
      default 2

config MESH_PATH
      int 
      default 5

config MESH_PROXY
      int 
      default 5

config WIFI_P2P
      int 
      default 0

config WIFI_MURX
      bool 
      default y

config ONLY_HSU
      bool 
      default y

config WIFI_HSU
      int 
      default 2

config WIFI_CMON
      bool 
      default y

config WIFI_MROLE
      bool 
      default y

config WIFI_HWSCAN
      bool 
      default y

config WIFI_AUTOBCN
      bool 
      default y

config WIFI_HE
      bool 
      default y

config WIFI_BARX
      int 
      default 4

config WIFI_REORDBUF
      int 
      default 4

config WIFI_BATX
      int 
      default 1

config WIFI_MFP
      bool 
      default y

config WIFI_AMT_VERSION
      bool 
      default y

config COMP_DEBUG_WIFI
      bool 
      default y

config ECR6600_WIFI_DBG_LEVEL0
      bool 
      default y

config ECR6600_WIFI_DBG_LEVEL
      int 
      default 0

config CRM
      bool 
      default y

config IPC_DMA
      bool 
      default y

config INTC
      bool 
      default y

config IPC_FHOST
      bool 
      default y

config WIFIPHY
      bool 
      default y

config WIFI_PHY_CUSTOM_RF
      bool 
      default y

config WIFI_PHY_TYPE
      string 
      default "custom_rf"

config SYSCTRL
      bool 
      default y

config TIME
      bool 
      default y

config ASIC_RF
      bool 
      default y
```

## eswin_ecr6600_1.0.23/eswin_ecr6600_1.0.23_temp/eswin_ecr6600_os/apps/Kconfig
```kconfig
source "apps/ble_apps/Kconfig"
source "apps/unit_test/Kconfig"
#source "apps/zeratul/Kconfig"
```

## eswin_ecr6600_1.0.23/eswin_ecr6600_1.0.23_temp/eswin_ecr6600_os/apps/ble_apps/Kconfig
```kconfig
choice 
	prompt "BLE Test Applications"
	depends on ECR_BLE && BLE_PRODUCT_BLEFULL

	config BLE_EXAMPLES_NONE
		bool "no ble examples"

	config BLE_EXAMPLES_NETCFG_SLAVE
		depends on BLE_PRODUCT_BLEFULL
		bool "ble netcfg example as slave"
	
	config BLE_TUYA_ADAPTER
		depends on BLE_PRODUCT_BLEFULL
		bool "ble tuya adapter"

endchoice
```

## eswin_ecr6600_1.0.23/eswin_ecr6600_1.0.23_temp/eswin_ecr6600_os/arch/Kconfig
```kconfig
comment "Build Setup"


config OUTPUT_FORMAT_ELF
	bool 
	default n
	
	
config OUTPUT_FORMAT_LIB
	bool 
	default n


choice
	prompt "LD Script Selectiong"
	default LD_SCRIPT_XIP

	config LD_SCRIPT_XIP
	bool "xip ld script"
	
	config LD_SCRIPT_RAM
	bool "ram ld script"
endchoice


choice
	prompt "Output Version Selectiong"
	default OUTPUT_VERSION_STANDALONE_ELF

	config OUTPUT_VERSION_STANDALONE_ELF
	bool "standalone elf"
	select OUTPUT_FORMAT_ELF
	
	config OUTPUT_VERSION_TRANSPORT_ELF
	bool "transport elf"
	select OUTPUT_FORMAT_ELF
	
	config OUTPUT_VERSION_LIB
	bool "lib"
	select OUTPUT_FORMAT_LIB
endchoice


config OPTION_ARCHOPTIMIZATION
	string
	default "-Os"
	
	
config BUILD_WARNING_ALL
	bool
	default y
	
	
#menu "Gcc Build Option"
#
#	choice
#		prompt "Parallel Build Thread Number Selection"
#		default PARALLEL_BUILD_ONE
#		
#		config PARALLEL_BUILD_ONE
#		bool "j1"
#		
#		config PARALLEL_BUILD_FOUR
#		bool "j4"
#		
#		config PARALLEL_BUILD_EIGHT
#		bool "j8"
#	endchoice
#
#	choice
#		prompt "Build Warning Configuration"
#		default BUILD_WARNING_ALL
#		
#		config BUILD_WARNING_ALL
#		bool "warning all"
#		
#		config BUILD_WARNING_NONE
#		bool "waring none"
#	endchoice
#
#
#	config BUILD_WARNING_ALL
#	bool
#	default y
#
#	config OPTION_ARCHOPTIMIZATION
#		string
#		default "-Os"
#	
#endmenu
```

## eswin_ecr6600_1.0.23/eswin_ecr6600_1.0.23_temp/eswin_ecr6600_os/components/ble_ctrl/Kconfig
```kconfig
menuconfig BLE_TUYA_ADAPTER_TEST
        bool "tuya BLE Application interface for test"
        depends on BLE_PRODUCT_BLEFULL
        default n 

menuconfig BLE_TUYA_HCI_ADAPTER_TEST
        bool "TUYA BLE hci interface for test"
        depends on BLE_EMB_PRESENT
        default n 
```

## eswin_ecr6600_1.0.23/eswin_ecr6600_1.0.23_temp/eswin_ecr6600_os/components/cli/Kconfig
```kconfig
menuconfig CLI
	bool "CLI Component Support"
	default y

menuconfig TUYA_DOORCONTACT
        bool "tuya door contact Support"
        default n
	
if CLI
	source "components/cli/command/Kconfig"
endif
```

## eswin_ecr6600_1.0.23/eswin_ecr6600_1.0.23_temp/eswin_ecr6600_os/components/iperf3/Kconfig
```kconfig
#
# For a description of the syntax of this configuration file,
# see the file kconfig-language.txt in the NuttX tools repository.
#

menuconfig WIRELESS_IPERF_3
	bool "IPERF_3"
	depends on ECR6600_WIFI
	default n
	select CJSON
```

## eswin_ecr6600_1.0.23/eswin_ecr6600_1.0.23_temp/eswin_ecr6600_os/components/lwip/Kconfig
```kconfig
menuconfig LWIP
	bool "LWIP Component Support"
	default y
	select WIRELESS_WPA_SUPPLICANT
	select SYSTEM_WIFI_CTRL
	select PHREAD
	
menuconfig IPV6
	bool "LWIP IPV6 Component Support"
	depends on LWIP
	default n
```

## eswin_ecr6600_1.0.23/eswin_ecr6600_1.0.23_temp/eswin_ecr6600_os/components/mqtt/Kconfig
```kconfig
menuconfig MQTT
	bool "MQTT Component Support"
	default n
	depends on LWIP
	depends on PHREAD
	select MBEDTLS
	select URLPARSER
```

## eswin_ecr6600_1.0.23/eswin_ecr6600_1.0.23_temp/eswin_ecr6600_os/components/wifi_ctrl/Kconfig
```kconfig
menuconfig SYSTEM_WIFI_CTRL
	bool "System wifi control Component Support"
	default y
```
