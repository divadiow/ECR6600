## ECR6600F_v2.1.22/freertos/Boards/ecr6600/at/Kconfig
```kconfig
menuconfig OTA
	bool "OTA support"

menuconfig OTA_LOCAL
	bool "OTA_LOCAL Servers Support"
	depends on OTA
	
menuconfig OTA_SERVICE
	bool "OTA_REMOTE Cloud Servers Support"
	depends on OTA
	select CJSON
	select MQTT
	
choice
	depends on OTA
	prompt "OTA Mode"
	default OTA_COMPRESSION_UPDATE

	#config OTA_NOT_SUPPORT_UPDATE	
	#bool "not support update"

	config OTA_COMPRESSION_UPDATE
	bool "compression update"

	config OTA_DIFFERENTIAL_UPDATE
	bool "differential update"

	config OTA_AB_UPDATE
	bool "AB update"
endchoice

config OTA_MODE_STRING
	string
	depends on OTA_COMPRESSION_UPDATE || OTA_DIFFERENTIAL_UPDATE || OTA_AB_UPDATE
	default "OTA_COMPRESSION_UPDATE" if OTA_COMPRESSION_UPDATE
	default "OTA_DIFFERENTIAL_UPDATE" if OTA_DIFFERENTIAL_UPDATE
	default "OTA_AB_UPDATE" if OTA_AB_UPDATE
```

## ECR6600F_v2.1.22/freertos/Boards/ecr6600/common/Kconfig
```kconfig
config CPU_ARCH
	string "CPU Architecture"
	default "andes"

choice
	prompt "Chip CPU Clock Source Selection"
	default CPU_CLK_SRC_96M
	
	config CPU_CLK_SRC_96M
		bool "CLK_96M"
	
	config CPU_CLK_SRC_160M
		bool "CLK_160M"

	config CPU_CLK_SRC_240M
		bool "CLK_240M"

	config CPU_CLK_SRC_40m
		bool "CLK_40M"

endchoice

choice
	prompt "Chip CPU Clock Frequency Division"
	default CPU_CLK_FREQ_DIV_0
	
	config CPU_CLK_FREQ_DIV_0
		bool "FREQ_DIV_0"
	
	config CPU_CLK_FREQ_DIV_2
		bool "FREQ_DIV_2"

	config CPU_CLK_FREQ_DIV_4
		bool "FREQ_DIV_4"

	config CPU_CLK_FREQ_DIV_8
		bool "FREQ_DIV_8"

endchoice


config CPU_ICACHE_ENABLE
	bool 
	default y

config CPU_DCACHE_ENABLE
	bool 
	default y
```

## ECR6600F_v2.1.22/freertos/Kconfig
```kconfig
menu "Build Setup"
source "arch/Kconfig"
endmenu # Build Setup


menu "Chip Features"
source "Boards/Kconfig"
endmenu

menu "RTOS Features"
source "os/Kconfig"
endmenu

menu "Device Drivers"
source "drivers/Kconfig"
endmenu


menu "Components Features"
source "components/Kconfig"
endmenu



source "PS/Kconfig"



menu "Application Configuration"
source "apps/Kconfig"
endmenu
	
menu "ref design specific Configuration"
source "$BOARD_DIR/Kconfig"
endmenu

mainmenu "ESWIN Configuration"

#config TOPDDIR
#	string 
#	option env="TOPDDIR"
#
#config BOARD_DIR
#	string
#	option env="BOARD_DIR"
```

## ECR6600F_v2.1.22/freertos/PS/Kconfig
```kconfig
config ECR_BLE
      bool 
      default y

config BLE_APP_ECR
      bool 
      default y

config BLE_APP
      bool 
      default y

config COMP_AES
      bool 
      default y

config COMP_DEBUG_BLE
      bool 
      default y

config COMP_ECC_P256
      bool 
      default y

config COMP_H4TL
      bool 
      default y

config COMP_RF
      bool 
      default y

config COMP_RWIP
      bool 
      default y

config BLE_RF_EXTRC
      bool 
      default y

config BLE_PRODUCT_BLEFULL
      bool 
      default y

config BLE_PRODUCT
      string 
      default "ble-full"

config BLE_BUBBLE
      bool 
      default y

config BLE_ROLE_ALL
      bool 
      default y

config BLE_ROLE
      string 
      default "all"

config LE_ACT
      int 
      default 3

config LE_CONN
      int 
      default 1

config BLE_HCITL
      bool 
      default y

config MULTIPLEX_UART
      bool 
      default y

config BLE_AHITL
      bool 
      default y

config BLE_ATTC
      bool 
      default y

config BLE_ATTS
      bool 
      default y

config BLE_SEC_CON
      int 
      default 32

config BLE_NBPRF
      int 
      default 10

config BLE_PROFILES
      bool 
      default y

config BLE_PROFILE_DISS
      bool 
      default y

config BLE_WLCOEX
      bool 
      default y

config BLE_RAL
      int 
      default 3

config BLE_HOST_PRESENT
      bool 
      default y

config BLE_AHI_PRESENT
      bool 
      default y

config BLE_SCH_PRESENT
      bool 
      default y

config BLE_RD_PICONET_CLK
      bool 
      default y

config ECR6600_WIFI
      bool 
      default y

config FULLMASK
      bool 
      default y

config WIFI_PRODUCT_FHOST
      bool 
      default y

config WIFI_PRODUCT
      string 
      default "fhost"

config WIFI_UMAC
      bool 
      default y

config WIFI_FHOST
      bool 
      default y

config WIFI_PLATFORM_VIRTEX7
      bool 
      default y

config WIFI_PLATFORM
      string 
      default "virtex7"

config WIFI_VIF
      int 
      default 4

config WIFI_STA
      int 
      default 8

config WIFI_MAC_VERSION21
      bool 
      default y

config WIFI_MAC_VERSION
      int 
      default 21

config WIFI_MDM_V30
      bool 
      default y

config WIFI_MDM_VERSION
      int 
      default 30

config WIFI_IPC_V11
      bool 
      default y

config WIFI_IPC_VERSION
      int 
      default 11

config WIFI_TXDESC0
      int 
      default 4

config WIFI_TXDESC1
      int 
      default 64

config WIFI_TXDESC2
      int 
      default 4

config WIFI_TXDESC3
      int 
      default 64

config WIFI_TXDESC4
      int 
      default 4

config WIFI_DPSM
      bool 
      default y

config WIFI_UF
      bool 
      default y

config WIFI_MON_DATA
      bool 
      default y

config WIFI_REC
      bool 
      default y

config WIFI_BCN
      bool 
      default y

config WIFI_AMSDURX
      int 
      default 12

config WIFI_SPC
      int 
      default 16

config WIFI_BFMEE
      bool 
      default y

config WIFI_BWLEN
      bool 
      default y

config WIFI_KEYCFG
      bool 
      default y

config WIFI_MESH_VIF
      int 
      default 0

config WIFI_MESH_LINK
      int 
      default 2

config MESH_PATH
      int 
      default 5

config MESH_PROXY
      int 
      default 5

config WIFI_P2P
      int 
      default 0

config WIFI_MURX
      bool 
      default y

config ONLY_HSU
      bool 
      default y

config WIFI_HSU
      int 
      default 2

config WIFI_CMON
      bool 
      default y

config WIFI_MROLE
      bool 
      default y

config WIFI_HWSCAN
      bool 
      default y

config WIFI_AUTOBCN
      bool 
      default y

config WIFI_HE
      bool 
      default y

config WIFI_BARX
      int 
      default 4

config WIFI_REORDBUF
      int 
      default 4

config WIFI_BATX
      int 
      default 4

config WIFI_MFP
      bool 
      default y

config WIFI_AMT_VERSION
      bool 
      default y

config COMP_DEBUG_WIFI
      bool 
      default y

config ECR6600_WIFI_DBG_LEVEL0
      bool 
      default y

config ECR6600_WIFI_DBG_LEVEL
      int 
      default 0

config CRM
      bool 
      default y

config IPC_DMA
      bool 
      default y

config INTC
      bool 
      default y

config IPC_FHOST
      bool 
      default y

config WIFIPHY
      bool 
      default y

config WIFI_PHY_CUSTOM_RF
      bool 
      default y

config WIFI_PHY_TYPE
      string 
      default "custom_rf"

config SYSCTRL
      bool 
      default y

config TIME
      bool 
      default y

config ASIC_RF
      bool 
      default y
```

## ECR6600F_v2.1.22/freertos/apps/jd/Kconfig
```kconfig
#menu "Jingdong Config"
	config JD_APP_SDK
	bool
	default n

	config JD_FREERTOS_PAL
	bool
	default n

	choice
		prompt "Jingdong Config"
		default NOT_SUPPORT_JD

		config JD_LED
		bool "JD LED_DEMO"
		select JD_APP_SDK
		select JD_FREERTOS_PAL

		config JD_BREAKER
		bool "JD BREAKER_DEMO"
		select JD_APP_SDK
		select JD_FREERTOS_PAL

		config JD_SWITCH
		bool "JD SWITCH_DEMO"
		select JD_APP_SDK
		select JD_FREERTOS_PAL

		config NOT_SUPPORT_JD
		bool "NOT SELECT JD"
	endchoice
#endmenu

menuconfig BLE_JD_ADAPTER
        bool "jd BLE Application interface for test"
        depends on BLE_PRODUCT_BLEFULL
        default n
```

## ECR6600F_v2.1.22/freertos/apps/lowpower/Kconfig
```kconfig
menu "psm demo app"

config CONFIG_PSM_DEMO_APP
	bool "psm demo app"
	default n

endmenu
```

## ECR6600F_v2.1.22/freertos/apps/spi_service/Kconfig
```kconfig
menu "SPI_SERVICE"

config SPI_SERVICE
	bool "spi service application"
	default n

config SPI_REPEATER
	bool "spi repeater application"
	depends on SPI_SERVICE
	default n

config VNET_SERVICE
	bool "virtual net application"
	depends on SPI_SERVICE
	default n

config SPI_SERVICE_UT
	bool "spi service unit test"
	depends on SPI_SERVICE
	default n
endmenu
```

## ECR6600F_v2.1.22/freertos/apps/tencent/Kconfig
```kconfig
#menu "Tencent cloud compiler config"
menuconfig TENCENT_CLOUD
	bool "Tencent cloud" 
	default n

	if TENCENT_CLOUD
		config BLE_TENCENT_ADAPTER
		bool "Tencent cloud ble net config" 
		default n
	endif
	
```

## ECR6600F_v2.1.22/freertos/components/Kconfig
```kconfig
source "components/cli/Kconfig"
source "components/pthread/Kconfig"
source "components/lwip/Kconfig"
source "components/nv/Kconfig"
source "components/wpa/Kconfig"
source "components/wifi_ctrl/Kconfig"
source "components/mbedtls/Kconfig"
source "components/iperf3/Kconfig"
source "components/cjson/Kconfig"
source "components/smartconfig/Kconfig"
source "components/sntp/Kconfig"
source "components/ble_ctrl/Kconfig"
source "components/fs/Kconfig"
source "components/telnet/Kconfig"
source "components/url_parser/Kconfig"
source "components/mqtt/Kconfig"
source "components/hostapd_ioctl/Kconfig"
source "components/health_monitor/Kconfig"
source "components/http_server/Kconfig"
source "components/web_config/Kconfig"
```

## ECR6600F_v2.1.22/freertos/components/cli/Kconfig
```kconfig
menuconfig CLI
	bool "CLI Component Support"
	default y
	
if CLI
	source "components/cli/command/Kconfig"
endif
```

## ECR6600F_v2.1.22/freertos/components/cli/command/Kconfig
```kconfig
menuconfig CMD_SHOW
	bool "show cmd sets"
	default y
	if CMD_SHOW
		config CMD_SHOW_SDK_VERSION
		bool "show sdk_version"
		default y
		
		config CMD_SHOW_REL_VERSION
		bool "show rel_version"
		default y
	endif

config CMD_READ
	bool "read 32-bit value(s) from a memory&reg location"
	default y

config CMD_WRITE
	bool "write 32-bit value(s) from a memory&reg location"
	default y

config CMD_HEALTH_MONITOR
	bool "add task-health monitor control cmd"
	depends on HEALTH_MONITOR
	default y

config CMD_ADC_HARDWARE
	bool "add adc cmd"
	depends on ADC
	default y

config CMD_BLE
	bool "add ble cmd"
	depends on ECR_BLE
	default y

config BLE_EMB_PRESENT
	bool "add ble emb present cmd"
	depends on ECR_BLE
	default n
	
config CMD_WIFI
	bool "add wifi cmd"
	depends on ECR6600_WIFI
	default y
	
config CMD_WIFI_AMT_VERSION
	bool "add wifi amt version cmd"
	depends on WIFI_AMT_VERSION
	default n
	
config CMD_WDT
	bool "add wdt cmd"
	depends on WDT
	default n

config CMD_SYSTEM_DEBUG
	bool "add system debug cmd"
	default y

config CMD_SNTP
	bool "add sntp cmd"
	depends on SNTP
	default n 

config CMD_SMARTCONFIG
	bool "add smartconfig cmd"
	depends on WIFI_SMARTCONFIG
	default n

config CMD_PSM
	bool "add psm cmd"
	depends on PSM_SURPORT
	default y

config CMD_OTA_SERVICE
	bool "add ota cmd"
	depends on OTA_SERVICE
	default n

config CMD_NV
	bool "add nv cmd"
	depends on NV
	default y

config CMD_IPERF_3
	bool "add iperf cmd"
	depends on WIRELESS_IPERF_3
	default n

config CMD_EFUSE
	bool "add efuse cmd"
	depends on EFUSE
	default n

config CMD_LA
	bool "add la cmd"
	default n
	if CMD_LA
		config LA
		bool "config LA"
		default n
	endif

config CMD_SDCARD
	bool "add sdcard cmd"
	select FATFS
	default n

config CMD_HTTPSERVER
	bool "add web server(url:http://ip_addr/setting)"
	select HTTPSERVER
	select WEB_CONFIG
	depends on CMD_WIFI
	default n

config CMD_MQTT
	bool "add mqtt cmd"
	depends on MQTT
	default y
```

## ECR6600F_v2.1.22/freertos/components/health_monitor/Kconfig
```kconfig
menuconfig HEALTH_MONITOR
	bool "task health monitor Support"
	depends on WDT
	default y

	if HEALTH_MONITOR
		config HEALTH_MON_TASK_MAX_NUM
		int "health monitor support max task"
		range 1 32
		default 16		

		config HEALTH_MON_DEBUG
		bool "reset when exception"
		default n		
	endif
```

## ECR6600F_v2.1.22/freertos/components/lwip/Kconfig
```kconfig
menuconfig LWIP
	bool "LWIP Component Support"
	default y
	select WIRELESS_WPA_SUPPLICANT
	select SYSTEM_WIFI_CTRL
	select PHREAD
	
menuconfig IPV6
	bool "LWIP IPV6 Component Support"
	depends on LWIP
	default n

if LWIP
	config LWIP_NAPT
	bool "lwip napt enable"
	default n

	config LWIP_MEM_SIZE
	int "lwip mem size"
	range 16384 65536
	default 25892

	config LWIP_TCP_SND_BUF
	int "lwip tcp snd buf size"
	range 4096 65536
	default 5840
	
	config LWIP_TCP_WND_BUF
	int "lwip tcp window size"
	range 4096 65536
	default 8760
endif
```

## ECR6600F_v2.1.22/freertos/components/mbedtls/Kconfig
```kconfig
menuconfig MBEDTLS
	bool "MBEDTLS Component Support"
	depends on LWIP
	default n
```

## ECR6600F_v2.1.22/freertos/components/mqtt/Kconfig
```kconfig
menuconfig MQTT
	bool "MQTT Component Support"
	default n
	depends on LWIP
	depends on PHREAD
	select MBEDTLS
	select URLPARSER

menuconfig MQTT_SSL
	bool "MQTT SSL Support"
	default y
	
```

## ECR6600F_v2.1.22/freertos/components/smartconfig/Kconfig
```kconfig
menuconfig WIFI_SMARTCONFIG
	bool "Wifi Smart Config Component Support"
	default n
```

## ECR6600F_v2.1.22/freertos/components/web_config/Kconfig
```kconfig
menuconfig WEB_CONFIG
	select HTTPSERVER
	bool "WEB_CONFIG Component Support"
	depends on CMD_HTTPSERVER
	default n
```

## ECR6600F_v2.1.22/freertos/components/wifi_ctrl/Kconfig
```kconfig
menuconfig SYSTEM_WIFI_CTRL
	bool "System wifi control Component Support"
	default y

if SYSTEM_WIFI_CTRL
	choice
	prompt "set wifi log level"
	default WIFI_LOG_LEVEL_DEBUG

	config WIFI_LOG_LEVEL_DEBUG
	bool "debug"
	
	config WIFI_LOG_LEVEL_INFO
	bool "info"

	config WIFI_LOG_LEVEL_WARN
	bool "warnning"

	config WIFI_LOG_LEVEL_ERROR
	bool "error"

	config WIFI_LOG_LEVEL_RAW
	bool "raw"

	config WIFI_LOG_LEVEL_NONE
	bool "none"
	endchoice

	config WIFI_USER_RECV_BUF_SIZE
	int "wifi user recv buf max size"
	range 32768 102400
	default 65536

	config WIFI_DRV_RECV_BUF_SIZE
	int "wifi driver recv buf max size"
	range 4096 131072
	default 12288

	config WIFI_AMPDU_TX_CNT
	int "wifi amsdu tx cnt"
	range 1 32
	default 3
endif
```

## ECR6600F_v2.1.22/freertos/components/wpa/Kconfig
```kconfig
#
# For a description of the syntax of this configuration file,
# see the file kconfig-language.txt in the NuttX tools repository.
#

menuconfig WIRELESS_WPA_SUPPLICANT
	bool "IEEE 802.11 WPA Supplicant"
	depends on ECR6600_WIFI
	default n
	
config ECR6600_DBGTRIM
	bool "Debug Trim"
	depends on ECR6600_WIFI
	default y

menuconfig WIRELESS_WPA3_SUPPORT
	bool "IEEE 802.11 WIRELESS_WPA3 Support, Need MBEDTLS and MFP Feature enabled"
	depends on WIRELESS_WPA_SUPPLICANT
	default n
	select MBEDTLS
	select WIFI_MFP
```
