## ECR6600F_v2.1.22/freertos/defconfig
```kconfig
CONFIG_CPU_CLK_SRC_160M=y
CONFIG_HEAP_BOUNDARY_CHECK=y
# CONFIG_SDIO_SLAVE is not set
CONFIG_QUAD_SPI=y
CONFIG_DRV_UNIT_TEST=y
CONFIG_DRV_UNIT_TEST_TIMER=y
CONFIG_DRV_UNIT_TEST_RTC=y
CONFIG_DRV_UNIT_TEST_FLASH=y
CONFIG_DRV_UNIT_TEST_GPIO=y
CONFIG_DRV_UNIT_TEST_EFUSE=y
CONFIG_DRV_UNIT_TEST_UART=y
CONFIG_DRV_UNIT_TEST_PWM=y
CONFIG_DRV_UNIT_TEST_AES=y
CONFIG_DRV_UNIT_TEST_HASH=y
CONFIG_DRV_UNIT_TEST_TRNG=y
CONFIG_DRV_UNIT_TEST_WDT=y
CONFIG_DRV_UNIT_TEST_ADC=y
CONFIG_DRV_UNIT_TEST_SPI=y
CONFIG_BLE_EMB_PRESENT=y
CONFIG_CMD_WIFI_AMT_VERSION=y
CONFIG_CMD_WDT=y
CONFIG_CMD_SNTP=y
CONFIG_CMD_SMARTCONFIG=y
CONFIG_CMD_OTA_SERVICE=y
CONFIG_CMD_IPERF_3=y
CONFIG_CMD_EFUSE=y
CONFIG_IPV6=y
# CONFIG_ECR6600_DBGTRIM is not set
CONFIG_WIRELESS_WPA3_SUPPORT=y
CONFIG_WIFI_DRV_RECV_BUF_SIZE=4096
CONFIG_WIRELESS_IPERF_3=y
CONFIG_WIFI_SMARTCONFIG=y
CONFIG_TELNET=y
CONFIG_BLE_EXAMPLES_NETCFG_SLAVE=y
CONFIG_OTA=y
CONFIG_OTA_LOCAL=y
CONFIG_OTA_SERVICE=y
```

## ECR6600F_v2.1.22/freertos/drivers/Kconfig
```kconfig
comment "soc drivers"

menu "UART_NUM"
	choice CLI_UART_NUM
		depends on CLI
		prompt "set cli uart num"
		default CLI_UART_0

		config CLI_UART_0
		bool "CLI_UART_0"

		config CLI_UART_1
		bool "CLI_UART_1"

		config CLI_UART_2
		bool "CLI_UART_2"
	endchoice

	choice AMT_UART_NUM
		prompt "set amt uart num"
		depends on WIFI_AMT_VERSION
		default SAME_TO_CLI_UART_NUM

		config SAME_TO_CLI_UART_NUM
		bool "SAME_TO_CLI_UART_NUM"
		
		config AMT_UART_0
		depends on CLI_UART_1 || CLI_UART_2
		bool "AMT_UART_0"

		config AMT_UART_1
		depends on CLI_UART_0 || CLI_UART_2
		bool "AMT_UART_1"

		config AMT_UART_2
		depends on CLI_UART_0 || CLI_UART_1
		bool "AMT_UART_2"
	endchoice
		
	choice AT_UART_NUM
		prompt "set at uart num"
		default AT_UART_1
		
		config AT_UART_0
		depends on CLI_UART_1 || CLI_UART_2
		bool "AT_UART_0"

		config AT_UART_1
		depends on CLI_UART_0 || CLI_UART_2
		bool "AT_UART_1"

		config AT_UART_2
		depends on CLI_UART_0 || CLI_UART_1
		bool "AT_UART_2"
	endchoice
	
	choice HCI_UART_NUM
		depends on STANDALONE_UART
		prompt "set hci uart num"
		default HCI_UART_1

		config HCI_UART_0
		depends on CLI_UART_1 || CLI_UART_2
		bool "HCI_UART_0"

		config HCI_UART_1
		depends on CLI_UART_0 || CLI_UART_2
		bool "HCI_UART_1"

		config HCI_UART_2
		depends on CLI_UART_0 || CLI_UART_1
		bool "HCI_UART_2"
	endchoice
endmenu

source "drivers/drivers/uart/Kconfig"
source "drivers/drivers/pit/Kconfig"
source "drivers/drivers/gpio/Kconfig"
source "drivers/drivers/dma/Kconfig"
source "drivers/drivers/aes/Kconfig"
source "drivers/drivers/hash/Kconfig"
source "drivers/drivers/trng/Kconfig"
source "drivers/drivers/sdio_slave/Kconfig"
source "drivers/drivers/sdhci/Kconfig"
source "drivers/drivers/sdcard/Kconfig"
source "drivers/drivers/pwm/Kconfig"
source "drivers/drivers/timer/Kconfig"
source "drivers/drivers/efuse/Kconfig"
source "drivers/drivers/flash/Kconfig"
source "drivers/drivers/ir/Kconfig"
source "drivers/drivers/adc/Kconfig"
source "drivers/drivers/i2c/Kconfig"
source "drivers/drivers/i2s/Kconfig"
source "drivers/drivers/rtc/Kconfig"
source "drivers/drivers/spi_master/Kconfig"
source "drivers/drivers/spi_slave/Kconfig"
source "drivers/drivers/wdt/Kconfig"
source "drivers/drivers/ecc/Kconfig"
source "drivers/drivers/encrypt_lock/Kconfig"
source "drivers/drivers/process_sensor/Kconfig"
source "drivers/unit_test/Kconfig"
```

## ECR6600F_v2.1.22/freertos/drivers/drivers/flash/Kconfig
```kconfig
menu "FLASH Driver Support"

config FLASH
	bool "FLASH Driver Support"
	default y

if FLASH
choice
	prompt "SPI MODE Selection"
	default STANDARD_SPI
	
	config STANDARD_SPI
		bool "Standard spi"

	config DUAL_SPI
		bool "Dual spi"

	config QUAD_SPI
		bool "Quad spi"
endchoice

choice
	prompt "SPI Clock Frequency Division"
	default SPI_CLK_DIV_0

	config SPI_CLK_DIV_0
		bool "FREQ_DIV_0"

	config SPI_CLK_DIV_2
		bool "FREQ_DIV_2"

	config SPI_CLK_DIV_4
		bool "FREQ_DIV_4"

	config SPI_CLK_DIV_6
		bool "FREQ_DIV_6"

	config SPI_CLK_DIV_8
		bool "FREQ_DIV_8"

	config SPI_CLK_DIV_10
		bool "FREQ_DIV_10"
endchoice

menu "FLASH Manufacturer's Support"

config FLASH_ALL_COMPATIBILITY
	bool "FLASH all select"
	default y
	select FLASH_GD
	select FLASH_PUYA
	select FLASH_ZB
	select FLASH_XM
	select FLASH_XT
	select FLASH_FM
	select FLASH_HUABANG
	select FLASH_EN
	select FLASH_TH
	select FLASH_BOYA
	#GD25Q80E,GD25Q16E 

config FLASH_GD
	bool "FLASH_GD"
	#GD25Q80E,GD25Q16E 
		
config FLASH_PUYA
	bool "FLASH_PUYA"
	#P25Q80HD,P25Q16H,P25Q16SH,P25Q32H 
	
config FLASH_ZB
	bool "FLASH_ZB"
	#ZB25VQ80,ZB25VQ16,ZB25VQ32 

config FLASH_XM
	bool "FLASH_XM"
	#XM25QH80B,XM25QH16B,XM25QH16C 
		
config FLASH_XT
	bool "FLASH_XT"
	#XT25F08B,XT25F16B,XT25F16F
		
config FLASH_FM
	bool "FLASH_FM"
	#FM25QH16B 
	
config FLASH_HUABANG
	bool "FLASH_HUABANG"
	#W25Q32JV 
	
config FLASH_EN
	bool "FLASH_EN"
	#EN25Q16B 
	
config FLASH_TH
	bool "FLASH_TH"
	#TH25Q16HB 
	
config FLASH_BOYA
	bool "FLASH_BOYA"
	#BY25Q32CS
	
endmenu # menu "FLASH Manufacturer's Support"

endif

endmenu # menu "SPI Flash Support"
```

## ECR6600F_v2.1.22/freertos/drivers/unit_test/Kconfig
```kconfig
menu "Driver UNIT TEST Support"

config DRV_UNIT_TEST
    bool "driver unit test"
    default n

if DRV_UNIT_TEST

    config DRV_UNIT_TEST_I2S
        bool "driver_i2s unit test"
        default n

    config DRV_UNIT_TEST_TIMER
        bool "driver_timer unit test"
        default n
	
    config DRV_UNIT_TEST_RTC
    	depends on SNTP
        bool "driver_rtc unit test"
        default n
		
	config DRV_UNIT_TEST_FLASH
        bool "driver_flash unit test"
        default n

    config DRV_UNIT_TEST_GPIO
        bool "driver_gpio unit test"
        default n

    config DRV_UNIT_TEST_EFUSE
        bool "driver_efuse unit test"
        default n
    
    config DRV_UNIT_TEST_UART
        bool "driver_uart unit test"
        default n
    
    config DRV_UNIT_TEST_PWM
        bool "driver_pwm unit test"
        default n

    config DRV_UNIT_TEST_AES
        bool "driver_aes unit test"
        default n

    config DRV_UNIT_TEST_HASH
        bool "driver_hash unit test"
        default n

    config DRV_UNIT_TEST_ECC
        bool "driver_ecc unit test"
        default n

    config DRV_UNIT_TEST_TRNG
        bool "driver_trng unit test"
        default n

    config DRV_UNIT_TEST_WDT
        bool "driver_wdt unit test"
        default n
		
	config DRV_UNIT_TEST_ADC
        bool "driver_adc unit test"
        default n
	
	config DRV_UNIT_TEST_SPI
        bool "driver_spi unit test"
        default n
		
	config DRV_UNIT_TEST_PROCESS_SENSOR
        bool "driver_process_sensor unit test"
        default n
endif

endmenu # menu "Driver UNIT TEST Support"
```

## ECR6600F_v2.1.22/freertos/os/Kconfig
```kconfig
comment "RTOS Configuration Start"

config FREERTOS
	bool
	select PIT
	select TRNG
	select OS_TICK_COMPENSTATION
	default y

config RTOS
	string
	default "freertos"

config CEVA_RTOS
	bool
	default n


menu "RTOS Debug Configuration"


config TASK_IRQ_SWITCH_TRACE
	bool "Trace Tasks&Irq Switch. Help in Crash Location, Development Stage Recommended to Open"
	default y
	---help---
		Set the latest TASK_ IRQ_ SWITCH_ The thread running/interrupted running of TRACE times is recorded in the global variable. It is used to understand the running conditions before exceptions when  debugging.
	if TASK_IRQ_SWITCH_TRACE
		config TASK_IRQ_SWITCH_TRACE_NUM
		int "Trace Tasks&Irq Switch Buff Size"
		default 10
	endif


config HEAP_BOUNDARY_CHECK
	bool "Heap Bounary Check When Heap_free. Small Cost of Space&Time, Development Stage Recommended to Open"
	default n
	---help---
		Check the mark when the memory is free to ensure that the heap does not overflow


config HEAP_CHECK_WHEN_TASK_SWITCHING
	bool "Heap List Check When Tasks Switching. A Lot Cost on Switch, Debug Recommended to Open"
	default n
	---help---
		This function is a memory heap and stack detection function developed by eswin and can replace the configCHECK of FreeRTOS_ FOR_ STACK_ OVERFLOW function


config FREERTOS_configCHECK_FOR_STACK_OVERFLOW
	int "Freertos Config: configCHECK_FOR_STACK_OVERFLOW"
	default 0
	---help---
		FreeRTOS native stack detection function, which can be configured, but is not recommended. HEAP_CHECK_WHEN_TASK_SWITCHING can override this function


config HEAP_DEBUG
	bool "[heaptrace]Heap Usage Stats Trace, Heap Application Record. It will increase the bin file, Memory Leak Problem Recommended to Open"
	default n
	---help---
		Add records of application files and line numbers to the memory control block to count complete memory usage information, which is helpful for memory debugging


config RUNTIME_DEBUG
	bool "[cpu]Tasks&Irq Runtime Record, CPU usage. Recommended to Close"
	default n
	---help---
		It is used to obtain the CPU utilization rate and analyze the thread/interrupt operation

config TASK_IRQ_RUN_NUM
	bool "[switch_num]Count Running Number of Tasks&Irq, Debug, Recommended to Close"
	default n
	---help---
		Counting the number of threads/interrupts running in a time period is helpful to analyze thread running


config FLASH_DUMP
	bool "Save Crash Information to Flash"
	default n
	---help---
		The crash information is saved to flash. Use 8KB at the end of the cpu partition


config SYSTEM_IRQ
	bool "System Irq Runtime Record, Debug Function, Recommended to Close"
	default n


config OS_TICK_COMPENSTATION
	bool "OS Tick Compensation"
	default y

endmenu

comment "RTOS Configuration End"
```

## eswin_ecr6600_1.0.23/eswin_ecr6600_1.0.23_temp/eswin_ecr6600_os/Boards/Kconfig
```kconfig
comment "Chip Features"


#choice
#	prompt "Chip Selection"
#	default ECR6600
#	config ECR2560
#		bool "ECR2560"
#	config ECR6600
#		bool "ECR6600"
#endchoice
config ECR6600
	bool
	select CLI
	default y


if ECR6600
	menu "ECR6600 CHIP Fetures"
		source "Boards/ecr6600/common/Kconfig"
	endmenu
	
	source "Boards/ecr6600/common/psm/Kconfig"
endif
```

## eswin_ecr6600_1.0.23/eswin_ecr6600_1.0.23_temp/eswin_ecr6600_os/Boards/ecr6600/common/psm/Kconfig
```kconfig
config PSM_SURPORT
      bool 
      default y

config WIFI_TWT
      bool 
      default y
```

## eswin_ecr6600_1.0.23/eswin_ecr6600_1.0.23_temp/eswin_ecr6600_os/Boards/ecr6600/tuya/Kconfig
```kconfig
menuconfig OTA
	bool "OTA support"

menuconfig OTA_LOCAL
	bool "OTA_LOCAL Servers Support"
	depends on OTA
	
menuconfig OTA_SERVICE
	bool "OTA_REMOTE Cloud Servers Support"
	depends on OTA
	
choice
	depends on OTA
	prompt "OTA Mode"
	default OTA_COMPRESSION_UPDATE

	config OTA_DEFAULT_MODE
	bool "default mode, determined by first upgrade"

	#config OTA_NOT_SUPPORT_UPDATE	
	#bool "not support update"

	config OTA_COMPRESSION_UPDATE
	bool "compression update"

	config OTA_DIFFERENTIAL_UPDATE
	bool "differential update"

	config OTA_AB_UPDATE
	bool "AB update"
endchoice

config OTA_MODE_STRING
	string
	depends on OTA_DEFAULT_MODE || OTA_NOT_SUPPORT_UPDATE || OTA_COMPRESSION_UPDATE || OTA_DIFFERENTIAL_UPDATE || OTA_AB_UPDATE
	default "OTA_DEFAULT_MODE" if OTA_DEFAULT_MODE
	default "OTA_NOT_SUPPORT_UPDATE" if OTA_NOT_SUPPORT_UPDATE
	default "OTA_COMPRESSION_UPDATE" if OTA_COMPRESSION_UPDATE
	default "OTA_DIFFERENTIAL_UPDATE" if OTA_DIFFERENTIAL_UPDATE
	default "OTA_AB_UPDATE" if OTA_AB_UPDATE
```
