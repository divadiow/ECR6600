## eswin_ecr6600_1.0.23/eswin_ecr6600_1.0.23_temp/eswin_ecr6600_os/Boards/ecr6600/tuya/defconfig
```kconfig
#
# Build Setup
#

#
# Build Setup
#
CONFIG_OUTPUT_FORMAT_ELF=y
CONFIG_LD_SCRIPT_XIP=y
# CONFIG_LD_SCRIPT_RAM is not set
CONFIG_OUTPUT_VERSION_STANDALONE_ELF=y
# CONFIG_OUTPUT_VERSION_TRANSPORT_ELF is not set
# CONFIG_OUTPUT_VERSION_LIB is not set
CONFIG_OPTION_ARCHOPTIMIZATION="-Os"
CONFIG_BUILD_WARNING_ALL=y
# end of Build Setup

#
# Chip Features
#

#
# Chip Features
#
CONFIG_ECR6600=y

#
# ECR6600 CHIP Fetures
#
CONFIG_CPU_ARCH="andes"
# CONFIG_CPU_CLK_SRC_96M is not set
CONFIG_CPU_CLK_SRC_160M=y
# CONFIG_CPU_CLK_SRC_240M is not set
# CONFIG_CPU_CLK_SRC_40m is not set
CONFIG_CPU_CLK_FREQ_DIV_0=y
# CONFIG_CPU_CLK_FREQ_DIV_2 is not set
# CONFIG_CPU_CLK_FREQ_DIV_4 is not set
# CONFIG_CPU_CLK_FREQ_DIV_8 is not set
CONFIG_CPU_ICACHE_ENABLE=y
CONFIG_CPU_DCACHE_ENABLE=y
# end of ECR6600 CHIP Fetures

#
# PSM Configuration Start
#
CONFIG_PSM_SURPORT=y
# CONFIG_PSM_SUPER_LOWPOWER is not set
CONFIG_WIFI_TWT=y

#
# PSM Configuration End
#
# end of Chip Features

#
# RTOS Features
#

#
# RTOS Configuration
#
CONFIG_FREERTOS=y
CONFIG_RTOS="freertos"

#
# RTOS Debug Configuration
#
CONFIG_HEAP_BOUNDARY_CHECK=y
# CONFIG_HEAP_DEBUG is not set
# CONFIG_RUNTIME_DEBUG is not set
CONFIG_IRQ_STATS_DEBUG=y
# CONFIG_SYSTEM_IRQ is not set
# end of RTOS Debug Configuration
# end of RTOS Features

#
# Device Drivers
#

#
# soc drivers
#

#
# UART_NUM
#
# CONFIG_CLI_UART_0 is not set
# CONFIG_CLI_UART_1 is not set
CONFIG_CLI_UART_2=y
# CONFIG_SAME_TO_CLI_UART_NUM is not set
CONFIG_AMT_UART_0=y
# CONFIG_AMT_UART_1 is not set
# CONFIG_AT_UART_0 is not set
CONFIG_AT_UART_1=y
# end of UART_NUM

CONFIG_UART=y
CONFIG_PIT=y
CONFIG_GPIO=y
CONFIG_DMA=y
CONFIG_AES=y
CONFIG_HASH=y
CONFIG_TRNG=y
CONFIG_SDIO_SLAVE=y
# CONFIG_SDHCI is not set
# CONFIG_SDCARD is not set
CONFIG_PWM=y
CONFIG_TIMER=y
CONFIG_EFUSE=y

#
# FLASH Driver Support
#
CONFIG_FLASH=y
CONFIG_STANDARD_SPI=y
# CONFIG_DUAL_SPI is not set
# CONFIG_QUAD_SPI is not set
CONFIG_SPI_CLK_DIV_0=y
# CONFIG_SPI_CLK_DIV_2 is not set
# CONFIG_SPI_CLK_DIV_4 is not set
# CONFIG_SPI_CLK_DIV_6 is not set
# CONFIG_SPI_CLK_DIV_8 is not set
# CONFIG_SPI_CLK_DIV_10 is not set

#
# FLASH Manufacturer's Support
#
CONFIG_FLASH_ALL_COMPATIBILITY=y
CONFIG_FLASH_GD=y
CONFIG_FLASH_PUYA=y
CONFIG_FLASH_ZB=y
CONFIG_FLASH_XM=y
CONFIG_FLASH_XT=y
CONFIG_FLASH_FM=y
CONFIG_FLASH_HUABANG=y
CONFIG_FLASH_EN=y
CONFIG_FLASH_TH=y
CONFIG_FLASH_BOYA=y
# end of FLASH Manufacturer's Support
# end of FLASH Driver Support

CONFIG_IR=y
CONFIG_ADC=y
CONFIG_I2C=y
CONFIG_I2S=y
CONFIG_RTC=y
CONFIG_SPI_MASTER=y
CONFIG_SPI_SLAVE=y
CONFIG_WDT=y
CONFIG_WDT_FEED_TASK=y
CONFIG_ANALYZE_REBOOT_TYPE=y
CONFIG_ECC=y
CONFIG_ENCRYPT_LOCK=y
# end of Device Drivers

#
# Components Features
#
CONFIG_CLI=y
CONFIG_TUYA_DOORCONTACT=y
CONFIG_CMD_SHOW=y
CONFIG_CMD_SHOW_SDK_VERSION=y
CONFIG_CMD_SHOW_REL_VERSION=y
CONFIG_CMD_READ=y
CONFIG_CMD_WRITE=y
# CONFIG_CMD_HEALTH_MONITOR is not set
# CONFIG_CMD_ADC_HARDWARE is not set
# CONFIG_CMD_BLE is not set
CONFIG_BLE_EMB_PRESENT=y
CONFIG_CMD_WIFI=y
CONFIG_CMD_WIFI_AMT_VERSION=y
# CONFIG_CMD_WDT is not set
CONFIG_CMD_SYSTEM_DEBUG=y
CONFIG_CMD_PSM=y
CONFIG_CMD_NV=y
# CONFIG_CMD_EFUSE is not set
# CONFIG_CMD_LA is not set
# CONFIG_CMD_HTTPSERVER is not set
# CONFIG_LWIP is not set
CONFIG_NV=y
# CONFIG_WIRELESS_WPA_SUPPLICANT is not set
# CONFIG_SYSTEM_WIFI_CTRL is not set
# CONFIG_WIRELESS_IPERF_3 is not set
# CONFIG_CJSON is not set
# CONFIG_WIFI_SMARTCONFIG is not set
# CONFIG_SNTP is not set
# CONFIG_BLE_TUYA_HCI_ADAPTER_TEST is not set
# CONFIG_FATFS is not set
# CONFIG_URLPARSER is not set
CONFIG_CUSTOM_FHOSTAPD=y
CONFIG_HEALTH_MONITOR=y
CONFIG_HEALTH_MON_TASK_MAX_NUM=16
# CONFIG_HEALTH_MON_DEBUG is not set
# end of Components Features

#
# Wireless Support
#

#
# WIRELESS Configuration Start
#
CONFIG_ECR_BLE=y
# CONFIG_BLE_APP_ECR is not set
CONFIG_BLE_APP_NONE=y

#
# BLE Module
#
CONFIG_COMP_AES=y
# CONFIG_COMP_DEBUG_BLE is not set
CONFIG_COMP_ECC_P256=y
CONFIG_COMP_H4TL=y
CONFIG_COMP_HCI_ADAPT=y
CONFIG_COMP_RF=y
CONFIG_COMP_RWIP=y
# CONFIG_BLE_RF_RIPPLE is not set
# CONFIG_BLE_RF_ATLAS is not set
CONFIG_BLE_RF_EXTRC=y
# end of BLE Module

CONFIG_BLE_PRODUCT_SPLITEMB=y
# CONFIG_BLE_PRODUCT_BLEFULL is not set
CONFIG_BLE_PRODUCT="ble-splitemb"
# CONFIG_BLE_BOARD_DISPLAY is not set
# CONFIG_BLE_GAIA is not set
CONFIG_BLE_BUBBLE=y
# CONFIG_BLE_ROLE_CENTRAL is not set
# CONFIG_BLE_ROLE_OBSERVER is not set
# CONFIG_BLE_ROLE_BROADCASTER is not set
# CONFIG_BLE_ROLE_PERIPHERAL is not set
CONFIG_BLE_ROLE_PERIPHERAL_OBSERVER=y
# CONFIG_BLE_ROLE_ALL is not set
# CONFIG_BLE_ROLE_NONCON is not set
CONFIG_BLE_ROLE="peripheral&observer"
CONFIG_LE_ACT=3
# CONFIG_BLE_NVDS is not set
CONFIG_BLE_HCITL=y
# CONFIG_BLE_TEST_RX_DUMP is not set
# CONFIG_STANDALONE_UART is not set
CONFIG_MULTIPLEX_UART=y

#
# BLE Host Specifics
#
# end of BLE Host Specifics

CONFIG_BLE_SEC_CON=32
# CONFIG_BLE_CRYPTO_UT is not set

#
# Profiles Feature
#
# end of Profiles Feature

#
# Mesh Feature
#
# end of Mesh Feature

CONFIG_BLE_WLCOEX=y
# CONFIG_BLE_WLCOEXTST is not set
# CONFIG_BLE_AOA is not set
# CONFIG_BLE_AOD is not set
# CONFIG_BLE_CON_CTE_REQ is not set
# CONFIG_BLE_CON_CTE_RSP is not set
# CONFIG_BLE_CONLESS_CTE_TX is not set
# CONFIG_BLE_CONLESS_CTE_RX is not set
CONFIG_BLE_RAL=1
CONFIG_BLE_SCH_PRESENT=y
# CONFIG_BLE_RD_PICONET_CLK is not set
# CONFIG_BLE_AFS_EXT is not set
# CONFIG_BLE_MBP is not set
# CONFIG_RP_HWSIM_BYPASS is not set
# CONFIG_ECR_BLE_DBG is not set
CONFIG_ECR6600_WIFI=y
# CONFIG_FPGA is not set
CONFIG_FULLMASK=y
# CONFIG_WIFI_PRODUCT_LMAC is not set
# CONFIG_WIFI_PRODUCT_FMAC is not set
CONFIG_WIFI_PRODUCT_FHOST=y
CONFIG_WIFI_PRODUCT="fhost"
CONFIG_WIFI_UMAC=y
CONFIG_WIFI_FHOST=y
CONFIG_WIFI_PLATFORM_VIRTEX7=y
# CONFIG_WIFI_PLATFORM_CUSTOM is not set
CONFIG_WIFI_PLATFORM="virtex7"
# CONFIG_WIFI_PROF is not set
# CONFIG_WIFI_STATS is not set
CONFIG_WIFI_VIF=4
CONFIG_WIFI_STA=8
# CONFIG_WIFI_MAC_VERSION10 is not set
# CONFIG_WIFI_MAC_VERSION20 is not set
CONFIG_WIFI_MAC_VERSION21=y
CONFIG_WIFI_MAC_VERSION=21
# CONFIG_WIFI_MDM_V10 is not set
# CONFIG_WIFI_MDM_V11 is not set
# CONFIG_WIFI_MDM_V20 is not set
# CONFIG_WIFI_MDM_V21 is not set
# CONFIG_WIFI_MDM_V22 is not set
CONFIG_WIFI_MDM_V30=y
CONFIG_WIFI_MDM_VERSION=30
# CONFIG_WIFI_IPC_V10 is not set
CONFIG_WIFI_IPC_V11=y
CONFIG_WIFI_IPC_VERSION=11

#
# Number of descriptors in BK TX queue[TXDESC]
#
CONFIG_WIFI_TXDESC0=4
CONFIG_WIFI_TXDESC1=4
CONFIG_WIFI_TXDESC2=4
CONFIG_WIFI_TXDESC3=4
CONFIG_WIFI_TXDESC4=4
# end of Number of descriptors in BK TX queue[TXDESC]

# CONFIG_WIFI_POWERSVAE is not set
# CONFIG_WIFI_UAPSD is not set
CONFIG_WIFI_DPSM=y
# CONFIG_WIFI_RADAR is not set
# CONFIG_WIFI_UF is not set
CONFIG_WIFI_MON_DATA=y
# CONFIG_WIFI_AMSDU is not set
CONFIG_WIFI_REC=y
CONFIG_WIFI_BCN=y
# CONFIG_WIFI_AGG is not set
CONFIG_WIFI_AMSDURX=8
CONFIG_WIFI_SPC=16
# CONFIG_WIFI_WAPI is not set
CONFIG_WIFI_BFMEE=y
CONFIG_WIFI_BWLEN=y
CONFIG_WIFI_KEYCFG=y
# CONFIG_WIFI_TDLS is not set
# CONFIG_WIFI_BFMER is not set

#
# Mesh Configuration
#
CONFIG_WIFI_MESH_VIF=0
CONFIG_WIFI_MESH_LINK=2
CONFIG_MESH_PATH=5
CONFIG_MESH_PROXY=5

#
# P2P Configuration
#
CONFIG_WIFI_P2P=0
# CONFIG_WIFI_P2P_GO is not set

#
# MU-MIMO Transmitter Configuration
#

#
# MU-MIMO receiver Configuration
#
CONFIG_WIFI_MURX=y

#
# HSU Configuration
#
# CONFIG_NO_HSU is not set
# CONFIG_PREFERRED_HSU is not set
CONFIG_ONLY_HSU=y
CONFIG_WIFI_HSU=2

#
# LMAC-only Configuration
#
CONFIG_WIFI_CMON=y
CONFIG_WIFI_MROLE=y
CONFIG_WIFI_HWSCAN=y
CONFIG_WIFI_AUTOBCN=y

#
# FMAC-only Configuration
#
# CONFIG_WIFI_VHT is not set
CONFIG_WIFI_HE=y
CONFIG_WIFI_BARX=4
CONFIG_WIFI_REORDBUF=4
CONFIG_WIFI_BATX=1
CONFIG_WIFI_MFP=y
# CONFIG_WIFI_ANT_DIV is not set
# CONFIG_WIFI_LMAC_TEST is not set
CONFIG_WIFI_AMT_VERSION=y
# CONFIG_WIFI_HTOL_VER is not set
CONFIG_COMP_DEBUG_WIFI=y
# CONFIG_FPGA_NEWRA_RF is not set

#
# wifi Debug
#
CONFIG_ECR6600_WIFI_DBG_LEVEL0=y
# CONFIG_ECR6600_WIFI_DBG_LEVEL1 is not set
# CONFIG_ECR6600_WIFI_DBG_LEVEL2 is not set
CONFIG_ECR6600_WIFI_DBG_LEVEL=0
# CONFIG_ECR6600_WIFI_DBGDUMP is not set
# CONFIG_ECR6600_WIFI_DBGDUMPKEY is not set
# CONFIG_ECR6600_WIFI_TRACE is not set

#
# wifi drivers
#
# CONFIG_BUTTON is not set
CONFIG_CRM=y
CONFIG_IPC_DMA=y
# CONFIG_EXTINT is not set
CONFIG_INTC=y
CONFIG_IPC_FHOST=y
CONFIG_WIFIPHY=y
# CONFIG_WIFI_PHY_TRIDENT is not set
# CONFIG_WIFI_PHY_KARST is not set
# CONFIG_WIFI_PHY_ELMA is not set
# CONFIG_WIFI_PHY_SDMB2B is not set
# CONFIG_WIFI_PHY_AETNENSIS is not set
CONFIG_WIFI_PHY_CUSTOM_RF=y
CONFIG_WIFI_PHY_TYPE="custom_rf"
CONFIG_SYSCTRL=y
CONFIG_TIME=y
CONFIG_ASIC_RF=y

#
# WIRELESS Configuration End
#
# end of Wireless Support

#
# Application Configuration
#

#
# Driver UNIT TEST Support
#
# CONFIG_DRV_UNIT_TEST is not set
# end of Driver UNIT TEST Support

#
# zeratul app
#
# CONFIG_ZERATUL_APP is not set
# end of zeratul app
# end of Application Configuration

#
# ref design specific Configuration
#
CONFIG_OTA=y
# CONFIG_OTA_LOCAL is not set
# CONFIG_OTA_SERVICE is not set
# CONFIG_OTA_DEFAULT_MODE is not set
CONFIG_OTA_COMPRESSION_UPDATE=y
# CONFIG_OTA_DIFFERENTIAL_UPDATE is not set
# CONFIG_OTA_AB_UPDATE is not set
CONFIG_OTA_MODE_STRING="OTA_COMPRESSION_UPDATE"
# end of ref design specific Configuration
```
